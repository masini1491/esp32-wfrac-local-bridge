## firmware/wfrac_bootstrap_probe/Kconfig.projbuild
```kconfig
menu "WF-RAC diagnostic bootstrap probe"

config WFRAC_PROBE_WEBUI_ENABLED
    bool "Enable temporary diagnostic SoftAP WebUI"
    default n
    help
        Diagnostic only, not production provisioning. Requires a local unique
        AP passphrase. One explicit form POST performs at most one STA connect
        and one read-only getDeviceInfo; no retry, polling or persistence.

config WFRAC_PROBE_AP_PASSWORD
    string "Local unique temporary diagnostic AP passphrase (8-63 bytes)"
    default ""
    depends on WFRAC_PROBE_WEBUI_ENABLED
    help
        Keep local configuration out of Git. Empty defaults fail closed.

config WFRAC_PROBE_ENABLED
    bool "Enable the one-shot diagnostic bootstrap probe"
    default n
    depends on !WFRAC_PROBE_WEBUI_ENABLED
    help
        Disabled by default. When disabled, the firmware does not seed time,
        initialize Wi-Fi, or make a WF-RAC request.

config WFRAC_PROBE_WIFI_SSID
    string "Wi-Fi station SSID"
    default ""
    depends on WFRAC_PROBE_ENABLED

config WFRAC_PROBE_WIFI_PASSWORD
    string "Wi-Fi station password"
    default ""
    depends on WFRAC_PROBE_ENABLED

config WFRAC_PROBE_HOST
    string "WF-RAC host"
    default ""
    depends on WFRAC_PROBE_ENABLED

config WFRAC_PROBE_PORT
    int "WF-RAC port"
    range 1 65535
    default 51443
    depends on WFRAC_PROBE_ENABLED

config WFRAC_PROBE_DEVICE_ID
    string "WF-RAC device ID"
    default ""
    depends on WFRAC_PROBE_ENABLED

config WFRAC_PROBE_OPERATOR_ID
    string "WF-RAC operator ID"
    default ""
    depends on WFRAC_PROBE_ENABLED

config WFRAC_PROBE_TIME_SEED
    string "Estimated Unix-seconds time seed"
    default ""
    depends on WFRAC_PROBE_ENABLED

choice WFRAC_PROBE_SCHEME
    prompt "Explicit diagnostic WF-RAC scheme"
    default WFRAC_PROBE_SCHEME_HTTPS
    depends on WFRAC_PROBE_ENABLED

config WFRAC_PROBE_SCHEME_HTTP
    bool "HTTP"

config WFRAC_PROBE_SCHEME_HTTPS
    bool "HTTPS"

endchoice

config WFRAC_PROBE_SERVER_CERT_PEM
    string "HTTPS server trust certificate PEM"
    default ""
    depends on WFRAC_PROBE_ENABLED && WFRAC_PROBE_SCHEME_HTTPS
    help
        Caller-supplied PEM trust material. Keep local configuration out of Git.

endmenu
```

## firmware/wfrac_bootstrap_probe/sdkconfig.defaults
```kconfig
CONFIG_ESP_PHY_CALIBRATION_AND_DATA_STORAGE=n
CONFIG_ESP_PHY_INIT_DATA_IN_PARTITION=n
```

## tests/espidf_http_client_integration_gatea_d2/sdkconfig.defaults
```kconfig
CONFIG_ESP_HTTP_CLIENT_ENABLE_HTTPS=y
CONFIG_ESP_HTTP_CLIENT_ENABLE_CUSTOM_TRANSPORT=y
CONFIG_ESP_TLS_USING_MBEDTLS=y
# CONFIG_MBEDTLS_CERTIFICATE_BUNDLE is not set
```
